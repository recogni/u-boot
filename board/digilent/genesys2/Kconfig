## board/digilent/genesys2/Kconfig
```kconfig
if TARGET_ARIANE_GENERIC

config SYS_CPU
	default "generic"

config SYS_BOARD
	default "genesys2"

config SYS_VENDOR
	default "digilent"

config SYS_SOC
	default "ariane"

config SYS_CONFIG_NAME
	default "ariane_generic"

config ENV_SIZE
	default 0x2000 if ENV_IS_IN_SPI_FLASH

config ENV_OFFSET
	default 0x140000 if ENV_IS_IN_SPI_FLASH

config SPL_TEXT_BASE
	default 0x800000

config SPL_OPENSBI_LOAD_ADDR
	default 0x01000000

config BOARD_SPECIFIC_OPTIONS # dummy
	def_bool y
	#select RISCV_NDS
	#select SUPPORT_SPL
	#imply SMP
	#imply SPL_RAM_SUPPORT
	#imply SPL_RAM_DEVICE

endif
```

## configs/ariane_generic_rv64_defconfig
```kconfig
#Brett: Copied from x25-ae350_defconfig
CONFIG_RISCV=y
#
#Adding 64BIT
#
CONFIG_CC_OPTIMIZE_FOR_SIZE=n
CONFIG_64BIT=y
CONFIG_SYS_TEXT_BASE=0x80000000
CONFIG_NR_DRAM_BANKS=1
CONFIG_ENV_SECT_SIZE=0x1000
CONFIG_TARGET_ARIANE_GENERIC=y
CONFIG_ARCH_RV64I=y
CONFIG_DISTRO_DEFAULTS=y
CONFIG_FIT=y
CONFIG_BOOTDELAY=0
#CONFIG_BOARD_EARLY_INIT_F=y
CONFIG_SYS_PROMPT="Recogni # "
#CONFIG_CMD_IMLS=y
CONFIG_CMD_MMC=y
CONFIG_CMD_SF_TEST=y
# CONFIG_CMD_SETEXPR is not set
CONFIG_BOOTP_PREFER_SERVERIP=y
CONFIG_CMD_CACHE=y
CONFIG_OF_PRIOR_STAGE=y
CONFIG_DEFAULT_DEVICE_TREE="ariane_generic"
CONFIG_ENV_IS_IN_SPI_FLASH=y
CONFIG_SYS_RELOC_GD_ENV_ADDR=y
CONFIG_NET_RANDOM_ETHADDR=y
CONFIG_MMC=y
CONFIG_BAUDRATE=115200
CONFIG_SYS_NS16550=y
#CONFIG_SPI=y
#CONFIG_ATCSPI200_SPI=y
#Try to fix up console
CONFIG_LOG_CONSOLE=y
CONFIG_CMD_CONSOLE=y
CONFIG_SPECIFY_CONSOLE_INDEX=y
CONFIG_CONS_INDEX=1
#
CONFIG_OF_CONTROL=y
CONFIG_OF_EMBED=y

CONFIG_TOOLS_DEBUG=y
CONFIG_DEBUG_UART=y
CONFIG_DEBUG_UART_BASE=0x10000000
CONFIG_DEBUG_UART_CLOCK=50000000
CONFIG_DM_SERIAL=y
CONFIG_DEBUG_UART_SHIFT=2


#CONFIG_TPL_BUILD=n
#CONFIG_SPL_BUILD=y
#CONFIG_SPL_ETH_SUPPORT=y
CONFIG_PHY_REALTEK=y
CONFIG_DM_ETH=y
CONFIG_XILINX_AXIEMAC=y
CONFIG_XILINX_EMACLITE=y
CONFIG_FPGA_XILINX=y
CONFIG_PHYLIB=y

CONFIG_CMD_BOOTM=y
CONFIG_BOOTM_OPENRTOS=y
CONFIG_CMD_IMI=y

#Ethernet related trials
#CONFIG_DM_MDIO=y
#CONFIG_DM_ETH=y
#CONFIG_RGMII=y
#CONFIG_MII=y
#CONFIG_PHY_XILINX=y
#CONFIG_PHY_REALTEK=y
#CONFIG_PHY_XILINX_GMII2RGMII=y
#CONFIG_NET_RANDOM_ETHERADDR=y
#CONFIG_XILINX_AXIEMAC=y
#CONFIG_PHY=y
#CONFIG_NET=y
#CONFIG_DM_MTD=y
#CONFIG_MTD=y
#CONFIG_CMD_MII=y
#PHYLIB=y
#CONFIG_PWM=y
#CONFIG_SIFIVE_PLIC=y
#
#
#CONFIG_FTSDC010=y
#CONFIG_FTSDC010_SDIO=y
#CONFIG_DM_MTD=y
#CONFIG_MTD_NOR_FLASH=y
#CONFIG_FLASH_CFI_DRIVER=y
#CONFIG_CFI_FLASH=y
#CONFIG_SYS_FLASH_USE_BUFFER_WRITE=y
#CONFIG_SYS_FLASH_CFI=y
#CONFIG_SF_DEFAULT_MODE=0x0
#CONFIG_SPI_FLASH_MACRONIX=y
#CONFIG_FTMAC100=y
```
